## dts/bindings/ieee802154/qorvo,dw3000.yaml
```yaml
# Copyright (c) 2022, RedNodeLabs.
# SPDX-License-Identifier: Apache-2.0

description: Qorvo DW3000 802.15.4 UWB transceiver

compatible: "qorvo,dw3000"

include: spi-device.yaml

properties:
    int-gpios:
      type: phandle-array
      required: true
      description: Interrupt pin.

        The interrupt pin IRQ of DW3000 is active high output.
        If connected directly the MCU pin should be configured
        as active high.

    reset-gpios:
      type: phandle-array
      required: true
      description: RESET pin.

        The RESET pin of DW3000 is active low.
        If connected directly the MCU pin should be configured
        as active low.

    tx-ant-delay:
      type: int
      required: false
      description: Transmitter antenna delay.

    rx-ant-delay:
      type: int
      required: false
      description: Receiver antenna delay.
```
